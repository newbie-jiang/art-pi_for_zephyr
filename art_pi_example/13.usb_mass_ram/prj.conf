## prj.conf
```kconfig
# CONFIG_GPIO=y

# # =========================
# # 通用（两种 FS 都需要）
# # =========================
CONFIG_FILE_SYSTEM=y
CONFIG_DISK_ACCESS=y
CONFIG_FILE_SYSTEM_MKFS=y


# #------------fatfs----------------
CONFIG_FAT_FILESYSTEM_ELM=y
CONFIG_FS_FATFS_MKFS=y    


# #------------ext2----------------------
CONFIG_FILE_SYSTEM_EXT2=y
CONFIG_TEST_RANDOM_GENERATOR=y
#ext2 的 mkfs 会用到比较深的调用栈/临时缓冲。建议把主线程栈增大到 8 KiB 起步
CONFIG_MAIN_STACK_SIZE=8192
#（可选，若在工作队列里做过 FS 操作，再给它加大）
CONFIG_SYSTEM_WORKQUEUE_STACK_SIZE=4096


# USB 设备栈 + MSC 类
CONFIG_USB_DEVICE_STACK=y
# 打开 MSC 类（具体 Kconfig 名称在不同版本略有差异，建议 menuconfig 里搜索 “Mass storage class / MSC” 勾选）
CONFIG_USB_MASS_STORAGE=y


# USB 描述符信息（按需）
CONFIG_USB_DEVICE_MANUFACTURER="Zephyr"
CONFIG_USB_DEVICE_PRODUCT="RAM Disk"
# VID/PID 不写也能用（默认），若需要自定义可设置：
# CONFIG_USB_DEVICE_VID=0x1234
# CONFIG_USB_DEVICE_PID=0x5678



# # 日志（可选）
# CONFIG_LOG=y
# CONFIG_LOG_DEFAULT_LEVEL=3


# #使用外部sdram开启
CONFIG_MEMC=y
CONFIG_MEMC_STM32=y
CONFIG_MEMC_STM32_SDRAM=y
```

## art_pi.overlay
```dts
/*
 * Copyright (c) 2025 STMicroelectronics
 *
 * SPDX-License-Identifier: Apache-2.0
 */

/*
 * Define the device, controller and partition to be the external memory
 * for running the application in external NOR from MCUboot
 */
/ {
	chosen {
		zephyr,flash = &w25q64_qspi;
		zephyr,flash-controller = &w25q64_qspi;
		zephyr,code-partition = &slot0_partition;
	};


   /* RAM 盘 #0：默认内存（不写 ram-region） */
//    ramdisk0 {
//         compatible = "zephyr,ram-disk";
//         status = "okay";
//         disk-name = "RAM";
//         sector-size = <512>;
//         sector-count = <192>;    /* 192*512 = 96 KiB */
//     };

    /* RAM 盘 #1：放外部 SDRAM */
    ramdisk0 {
        compatible = "zephyr,ram-disk";
        status = "okay";
        disk-name = "RAM";
        sector-size = <512>;
        sector-count = <10240>;  /* 5 MiB 举例 */
        ram-region = <&sdram1>;
    };


    
};
```

## ramdisk.overlay
```dts
/*
 * Copyright (c) 2023 Nordic Semiconductor ASA
 *
 * SPDX-License-Identifier: Apache-2.0
 */

/ {
	ramdisk0 {
		compatible = "zephyr,ram-disk";
		status = "okay";
		disk-name = "RAM";
		sector-size = <512>;
		sector-count = <192>;
	};
};
```

## src/main.c
```c
/*
  该示例使用 RAM 磁盘作为 USB 设备的存储介质。

  设备端先 mkfs FAT，再让主机使用  (不创建 FAT，第一次插入时需要手动格式化)

  CONFIG_FILE_SYSTEM_MKFS  该宏开关受 prj_conf控制,因此无需在main.c 中 #define CONFIG_FILE_SYSTEM_MKFS
*/



#include <zephyr/kernel.h>
#include <zephyr/usb/usb_device.h>
#include <zephyr/storage/disk_access.h>
#include <zephyr/fs/fs.h>
#include <ff.h>
#include <stdio.h>
#include <stdint.h>

void main(void)
{
    int rc;

    rc = disk_access_init("RAM");
    printk("disk_access_init rc=%d\n", rc);

#ifdef CONFIG_FILE_SYSTEM_MKFS
    /* 一次性在裸盘上创建 FAT（不挂载，直接指定设备名） */
    rc = fs_mkfs(FS_FATFS, (uintptr_t)"RAM", NULL, 0);
    printk("fs_mkfs(FAT,RAM) rc=%d\n", rc);
#endif

    rc = usb_enable(NULL);
    printk("usb_enable rc=%d\n", rc);

    while (1) {
        k_sleep(K_SECONDS(1));
    }
}
```
